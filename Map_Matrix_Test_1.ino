#include "FastLED.h"
#define NUM_LEDS 298
#define DATA_PIN 11
#define LED_TYPE WS2812
#define COLOR_ORDER GRB

CRGB leds[298];

const int xpos[] PROGMEM = {
  2813,
2747,
2681,
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2672,
2606
};
const int ypos[] PROGMEM = {
  138,
138,
138,
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838,
838
};

int r = 200;      // radius of circle
int h = 1400;     // x starting center of circle
int k = 450;    // y starting center of circle
int xspeed = 80;
int yspeed = 30;


void setup() { 
  delay(2000); // power-up safety delay 
  FastLED.addLeds<NEOPIXEL, 11>(leds, NUM_LEDS); 
  FastLED.setBrightness(50);
  FastLED.setMaxPowerInVoltsAndMilliamps(5,1500);
  set_max_power_indicator_LED(13);

  Serial.begin(9600);                                        // Initialize serial port for debugging.

  
}

void loop() {

  // Distance from point to a circle
  //  ∣(x1−h)2+(y1−k)2‾‾‾‾‾‾‾‾‾‾‾‾‾‾‾‾‾‾‾√−r∣∣∣
  // abs(sqrt((x-h)^2 + (y-k)^2) - r)

  

  for (int i = 0; i < NUM_LEDS; i++) {
    int x = pgm_read_word_near(xpos + i);                            // retrive the coordinates of each pixel
    int y = pgm_read_word_near(ypos + i);

    long xdist = pow(x-h, 2);
    long ydist = pow(y-k, 2);

    int square = sqrt(xdist + ydist);

    int distance = (square - r);

    if (distance < 0){
      distance = distance * -1;
    }

    // long distance = abs(sqrt( long sq(x-h) + sq(y-k) ) - r);  // calculate the distance of the pixel from the circle
    
    CRGB this_color;                                      // create a variable for the color

    // Set each pixel to the correct color (close to the circle is white)
    if (distance < 50) {
      this_color = CRGB(255, 255, 255);
      } else {
        this_color = CRGB(0, 0, 0);
      } 

    // Use the method to change the color of the pixel
    turnOnOneLight(this_color, i);
  }

  // Show the led strip
  FastLED.show();

  if (h + xspeed > 2800 && xspeed > 0) {
      xspeed = xspeed * -1;
      } 

  if (h + xspeed < 200 && xspeed < 0) {
      xspeed = xspeed * -1;
      } 

  if (k + yspeed > 800 && yspeed > 0) {
      yspeed = yspeed * -1;
      } 

  if (k + yspeed < 200 && yspeed < 0) {
      yspeed = yspeed * -1;
      } 

  h =  h + xspeed;
  k =  k + yspeed;

}

// Change the color of one pixel
void turnOnOneLight(CRGB color, int index){
    // Simple function to change the color of a LED and display the strip
    // Input an RGB color and the index of the light to change

    // Change the color of the led at this index
    leds[index] = color;
    
}
